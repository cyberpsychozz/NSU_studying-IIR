# file: Lab_2.ioc
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Mcu.Family=STM32F4
Mcu.Name=STM32F429ZITx
Mcu.Package=LQFP144
NVIC.PriorityGroup=NVIC_PRIORITYGROUP_4
PA13.Mode=Serial_Wire
PA13.Signal=SYS_JTMS-SWDIO
PA14.Mode=Serial_Wire
PA14.Signal=SYS_JTCK-SWCLK
PH0/OSC_IN.Mode=HSE-External-Oscillator
PH0/OSC_IN.Signal=RCC_OSC_IN
PH1/OSC_OUT.Mode=HSE-External-Oscillator
PH1/OSC_OUT.Signal=RCC_OSC_OUT
ProjectManager.HeapSize=0x200
ProjectManager.StackSize=0x400
ProjectManager.TargetToolchain=STM32CubeIDE
RCC.48MHZClocksFreq_Value=90000000
RCC.AHBFreq_Value=180000000
RCC.APB1CLKDivider=RCC_HCLK_DIV4
RCC.APB1Freq_Value=45000000
RCC.APB1TimFreq_Value=90000000
RCC.APB2CLKDivider=RCC_HCLK_DIV2
RCC.APB2Freq_Value=90000000
RCC.APB2TimFreq_Value=180000000
RCC.CortexFreq_Value=180000000
RCC.HCLKFreq_Value=180000000
RCC.HSE_VALUE=8000000
RCC.HSI_VALUE=16000000
RCC.LSE_VALUE=32768
RCC.PLLM=4
RCC.PLLN=180
RCC.PLLSourceVirtual=RCC_PLLSOURCE_HSE
RCC.SYSCLKFreq_VALUE=180000000
RCC.SYSCLKSource=RCC_SYSCLKSOURCE_PLLCLK
RCC.VCOOutputFreq_Value=360000000
board=custom

// file: Core/Src/main.c
/* USER CODE BEGIN Header */
/**
  ******************************************************************************
  * @file           : main.c
  * @brief          : Main program body
  ******************************************************************************
  * @attention
  *
  * Copyright (c) 2026 STMicroelectronics.
  * All rights reserved.
  *
  * This software is licensed under terms that can be found in the LICENSE file
  * in the root directory of this software component.
  * If no LICENSE file comes with this software, it is provided AS-IS.
  *
  ******************************************************************************
  */
/* USER CODE END Header */
#include "main.h"

void SystemClock_Config(void);
static void MX_GPIO_Init(void);

/* USER CODE BEGIN 0 */
GPIO_PinState GPIO_ReadPin(GPIO_TypeDef* GPIOx, uint16_t GPIO_Pin){
	  if((GPIOx->IDR & GPIO_Pin) != (uint32_t)GPIO_PIN_RESET){
		  return GPIO_PIN_SET;
	  }else{
		  return GPIO_PIN_RESET;
	  }
 }

 void GPIO_TogglePin(GPIO_TypeDef* GPIOx, uint16_t GPIO_Pin){
	  if((GPIOx->IDR & GPIO_Pin) != 0){
		   GPIOx->BSRR = (GPIO_Pin << 16);
	  }else{
		  GPIOx->BSRR = GPIO_Pin;
	  }
 }

 void GPIO_WritePin(GPIO_TypeDef* GPIOx, uint16_t GPIO_Pin, GPIO_PinState PinState) {
   if(PinState == GPIO_PIN_SET) {
     GPIOx->BSRR = GPIO_Pin;
   } else {
     GPIOx->BSRR = (GPIO_Pin << 16);
   }
 }
/* USER CODE END 0 */

int main(void)
{

  /* MCU Configuration--------------------------------------------------------*/

  /* Reset of all peripherals, Initializes the Flash interface and the Systick. */
  HAL_Init();

  /* Configure the system clock */
  SystemClock_Config();

  /* USER CODE BEGIN SysInit */
  RCC->AHB1ENR = RCC->AHB1ENR | RCC_AHB1ENR_GPIOGEN | RCC_AHB1ENR_GPIOAEN;
  GPIOA->MODER &= 0xFFFFFFFFC;
  GPIOG->MODER &= ~0x14000000;
  GPIOG->MODER |= 0x14000000;

  GPIOG->OTYPER &= 0xFFFF9FFF;

  GPIOA->OSPEEDR &= ~0x00000002;
  GPIOA->OSPEEDR |= 0x00000001;
  GPIOG->OSPEEDR &= ~0x28000000;
  GPIOG->OSPEEDR |= 0x14000000;

  GPIOA->PUPDR &= 0xFFFFFFFF3;
  GPIOG->PUPDR &= 0x3C000000;

  GPIOA->LCKR |= 0x00010001;
  GPIOG->LCKR |= 0x00016000;
  /* USER CODE END SysInit */

  /* Initialize all configured peripherals */
  MX_GPIO_Init();
  /* USER CODE BEGIN 2 */
  const uint16_t Led1_Pin = 0x2000;
  const uint16_t Led2_Pin = 0x4000;

  GPIO_WritePin(GPIOG, Led1_Pin|Led2_Pin, GPIO_PIN_RESET);
  int score1 = 0;
  int score2 = 0;
  int cube = 0;
  int Key_State = 0;
  int Prev_Key_State = 0;
  int lose1 = 0;
  int lose2 = 0;
  int curr_player = 0;
//  Key_State = HAL_GPIO_ReadPin(GPIOA, Key_Pin);
  /* USER CODE END 2 */

  /* Infinite loop */
  while (1)
  {
	Key_State = GPIO_ReadPin(GPIOA, 1);

	if(Key_State == 0 && Prev_Key_State == 1 && lose1 == 0 && lose2 ==0 ){
	   cube = (rand()%6)+1;

	   for(int i = 0; i < cube; i++){
		  if(curr_player == 0){
			  GPIO_TogglePin(GPIOG, Led1_Pin);
			  HAL_Delay(400);
			  GPIO_TogglePin(GPIOG, Led1_Pin);
			  HAL_Delay(400);
		  }else{
			  GPIO_TogglePin(GPIOG, Led2_Pin);
			  HAL_Delay(400);
			  GPIO_TogglePin(GPIOG, Led2_Pin);
			  HAL_Delay(400);
		  }

	   }

	   GPIO_WritePin(GPIOG, Led1_Pin|Led2_Pin, GPIO_PIN_RESET);

	   if(curr_player == 0){
		   score1 += cube;
	   }else{
		   score2 += cube;
	   }

	   if (score1 > 21){
		   lose1 = 1;
		   GPIO_WritePin(GPIOG, Led2_Pin, GPIO_PIN_SET);
	   }

	   if (score2 > 21){
	   		   lose2 = 1;
	   		   GPIO_WritePin(GPIOG, Led1_Pin, GPIO_PIN_SET);
	   }
	}

	Prev_Key_State = Key_State;

	if (lose1) {
	      GPIO_TogglePin(GPIOG, Led2_Pin);
	      HAL_Delay(1000);
	    }

	if(lose2){
		GPIO_TogglePin(GPIOG, Led1_Pin);
		HAL_Delay(1000);
	}
  }
}

void SystemClock_Config(void)
{
  RCC_OscInitTypeDef RCC_OscInitStruct = {0};
  RCC_ClkInitTypeDef RCC_ClkInitStruct = {0};

  /** Configure the main internal regulator output voltage
  */
  __HAL_RCC_PWR_CLK_ENABLE();
  __HAL_PWR_VOLTAGESCALING_CONFIG(PWR_REGULATOR_VOLTAGE_SCALE1);

  /** Initializes the RCC Oscillators according to the specified parameters
  * in the RCC_OscInitTypeDef structure.
  */
  RCC_OscInitStruct.OscillatorType = RCC_OSCILLATORTYPE_HSE;
  RCC_OscInitStruct.HSEState = RCC_HSE_ON;
  RCC_OscInitStruct.PLL.PLLState = RCC_PLL_ON;
  RCC_OscInitStruct.PLL.PLLSource = RCC_PLLSOURCE_HSE;
  RCC_OscInitStruct.PLL.PLLM = 4;
  RCC_OscInitStruct.PLL.PLLN = 180;
  RCC_OscInitStruct.PLL.PLLP = RCC_PLLP_DIV2;
  RCC_OscInitStruct.PLL.PLLQ = 4;
  if (HAL_RCC_OscConfig(&RCC_OscInitStruct) != HAL_OK)
  {
    Error_Handler();
  }

  /** Activate the Over-Drive mode
  */
  if (HAL_PWREx_EnableOverDrive() != HAL_OK)
  {
    Error_Handler();
  }

  /** Initializes the CPU, AHB and APB buses clocks
  */
  RCC_ClkInitStruct.ClockType = RCC_CLOCKTYPE_HCLK|RCC_CLOCKTYPE_SYSCLK
                              |RCC_CLOCKTYPE_PCLK1|RCC_CLOCKTYPE_PCLK2;
  RCC_ClkInitStruct.SYSCLKSource = RCC_SYSCLKSOURCE_PLLCLK;
  RCC_ClkInitStruct.AHBCLKDivider = RCC_SYSCLK_DIV1;
  RCC_ClkInitStruct.APB1CLKDivider = RCC_HCLK_DIV4;
  RCC_ClkInitStruct.APB2CLKDivider = RCC_HCLK_DIV2;

  if (HAL_RCC_ClockConfig(&RCC_ClkInitStruct, FLASH_LATENCY_5) != HAL_OK)
  {
    Error_Handler();
  }
}

static void MX_GPIO_Init(void)
{

  /* GPIO Ports Clock Enable */
  __HAL_RCC_GPIOH_CLK_ENABLE();
  __HAL_RCC_GPIOA_CLK_ENABLE();

}

void Error_Handler(void)
{
  __disable_irq();
  while (1)
  {
  }
}
